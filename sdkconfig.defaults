## sdkconfig.defaults
```kconfig
# ==============================================================
# ESP-IDF 默认项目配置 (sdkconfig.defaults)
# 作用：预设 Kconfig 选项，idf.py set-target 时会自动生成 sdkconfig
# ==============================================================

# --- 芯片目标 ---
# 使用 idf.py set-target esp32s3 来锁定芯片（不需在此配置）

# --- I²C 接口启用 ---
CONFIG_I2C_ENABLE_SLAVE=n
CONFIG_I2C_MASTER_ENABLE=y

# --- FreeRTOS 配置 ---
# 主任务栈大小（字节），足够存放 OLED 缓冲区
CONFIG_FREERTOS_MAIN_TASK_STACK_SIZE=4096

# --- 日志级别 ---
CONFIG_LOG_DEFAULT_LEVEL_INFO=y

# --- BLE 蓝牙 ---
CONFIG_BT_ENABLED=y
CONFIG_BT_BLUEDROID_ENABLED=y
CONFIG_BT_BLE_ENABLED=y
CONFIG_BT_GATTS_ENABLE=y
CONFIG_BT_BLE_42_FEATURES_SUPPORTED=y
CONFIG_BT_BLE_BLUFI_ENABLE=n

# --- 分区表（自定义 4MB factory 分区） ---
CONFIG_PARTITION_TABLE_CUSTOM=y
CONFIG_PARTITION_TABLE_CUSTOM_FILENAME="partitions.csv"
```
