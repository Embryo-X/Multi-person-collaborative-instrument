/**
 * ==============================================================
 * NV3007 液晶驱动 — 2.79" IPS 142x428 4-SPI
 * ==============================================================
 * 基于 esp_lcd_panel_io_spi（GPIO 矩阵任意引脚可用）
 * 初始化序列来自 ESPHome 社区验证版 (142x428, offset 12)
 * 若白屏/花屏需按屏厂 datasheet 校准
 * ==============================================================
 */

#include <string.h>
#include "freertos/FreeRTOS.h"
#include "freertos/task.h"
#include "esp_log.h"
#include "esp_check.h"
#include "esp_heap_caps.h"
#include "esp_lcd_panel_io.h"
#include "driver/spi_master.h"
#include "driver/gpio.h"

#include "nv3007.h"

static const char *TAG = "nv3007";

static esp_lcd_panel_io_handle_t g_io = NULL;

/* ==============================================================
 * 初始化命令表 (厂商模式 0xFF 0xA5 → 配置 → 0xFF 0x00 退出)
 * ============================================================== */
typedef struct { uint8_t cmd; uint8_t len; uint8_t data[8]; } init_cmd_t;

/* 官方 WH-279-05 (2.79寸 142x428) 初始化序列，照抄 STM32 例程 */
static const init_cmd_t NV3007_INIT[] = {
    {0xFF,1,{0xA5}},                    /* 进入厂商模式 */
    {0x9A,1,{0x08}}, {0x9B,1,{0x08}}, {0x9C,1,{0xB0}}, {0x9D,1,{0x16}}, {0x9E,1,{0xC4}},
    {0x8F,2,{0x55,0x04}}, {0x84,1,{0x90}}, {0x83,1,{0x7B}}, {0x85,1,{0x33}},
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    {0x6B,1,{0x13}}, {0x7B,1,{0x13}}, {0x6F,1,{0x00}}, {0x7F,1,{0x00}},
    /* 时序参数 */
    {0x50,1,{0x00}}, {0x52,1,{0xD6}}, {0x53,1,{0x08}}, {0x54,1,{0x08}}, {0x55,1,{0x1E}}, {0x56,1,{0x1C}},
    /* GOA map sel */
    {0xA0,3,{0x2B,0x24,0x00}}, {0xA1,1,{0x87}}, {0xA2,1,{0x86}},
    {0xA5,1,{0x00}}, {0xA6,1,{0x00}}, {0xA7,1,{0x00}},
    {0xA8,1,{0x36}}, {0xA9,1,{0x7E}}, {0xAA,1,{0x7E}},
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    {0xB6,1,{0x32}}, {0xB7,1,{0x7E}}, {0xB8,1,{0x7E}},
    /* 色彩校正 Gamma */
    {0xE0,1,{0x00}}, {0xE1,2,{0x03,0x0F}}, {0xE2,1,{0x04}}, {0xE3,1,{0x01}},
    {0xE4,1,{0x0E}}, {0xE5,1,{0x01}}, {0xE6,1,{0x19}}, {0xE7,1,{0x10}},
    {0xE8,1,{0x10}}, {0xEA,1,{0x12}}, {0xEB,1,{0xD0}}, {0xEC,1,{0x04}},
    {0xED,1,{0x07}}, {0xEE,1,{0x07}}, {0xEF,1,{0x09}},
    {0xF0,1,{0xD0}}, {0xF1,1,{0x0E}}, {0xF9,1,{0x17}}, {0xF2,4,{0x2C,0x1B,0x0B,0x20}},
    {0xE9,1,{0x29}}, {0xEC,1,{0x04}},
    /* TE */
    {0x35,1,{0x00}}, {0x44,2,{0x00,0x10}}, {0x46,1,{0x10}},
    /* 退出厂商模式 */
    {0xFF,1,{0x00}},
};
#define NV3007_INIT_COUNT  (sizeof(NV3007_INIT) / sizeof(NV3007_INIT[0]))

/* ==============================================================
 * 底层命令发送
 * ============================================================== */
static void nv3007_cmd(uint8_t cmd, const uint8_t *data, uint8_t len)
{
    esp_lcd_panel_io_tx_param(g_io, cmd, data, len);
}

/* ==============================================================
 * 初始化
 * ============================================================== */
esp_err_t nv3007_init(void)
{
    ESP_LOGI(TAG, "初始化 NV3007 %dx%d 4-SPI...", NV3007_WIDTH, NV3007_HEIGHT);

    /* 背光 BLK 接 3.3V 常亮，无 GPIO 控制 */

    /* SPI 总线 */
    spi_bus_config_t bus_cfg = {
        .mosi_io_num = NV3007_MOSI_IO,
        .miso_io_num = -1,
        .sclk_io_num = NV3007_SCLK_IO,
        .quadwp_io_num = -1,
        .quadhd_io_num = -1,
        .max_transfer_sz = NV3007_WIDTH * NV3007_HEIGHT * 2 + 10,
    };
    ESP_RETURN_ON_ERROR(spi_bus_initialize(SPI2_HOST, &bus_cfg, SPI_DMA_CH_AUTO),
                        TAG, "spi_bus_initialize");

    /* SPI Panel IO */
    esp_lcd_panel_io_spi_config_t io_cfg = {
        .cs_gpio_num = NV3007_CS_IO,
        .dc_gpio_num = NV3007_DC_IO,
        .spi_mode = 0,
        .pclk_hz = 20 * 1000 * 1000,
        .trans_queue_depth = 4,
        .lcd_cmd_bits = 8,
        .lcd_param_bits = 8,
    };
    ESP_RETURN_ON_ERROR(esp_lcd_new_panel_io_spi((esp_lcd_spi_bus_handle_t)SPI2_HOST,
                                                 &io_cfg, &g_io),
                        TAG, "esp_lcd_new_panel_io_spi");

    /* 硬件复位 */
    gpio_reset_pin(NV3007_RES_IO);
    gpio_set_direction(NV3007_RES_IO, GPIO_MODE_OUTPUT);
    gpio_set_level(NV3007_RES_IO, 0);
    vTaskDelay(pdMS_TO_TICKS(20));
    gpio_set_level(NV3007_RES_IO, 1);
    vTaskDelay(pdMS_TO_TICKS(120));

    /* 初始化命令序列 */
    for (uint32_t i = 0; i < NV3007_INIT_COUNT; i++)
        nv3007_cmd(NV3007_INIT[i].cmd, NV3007_INIT[i].data, NV3007_INIT[i].len);

    /* Sleep Out */
    esp_lcd_panel_io_tx_param(g_io, 0x11, NULL, 0);
    vTaskDelay(pdMS_TO_TICKS(200));

    /* 像素格式 RGB565（官方: 0x05） */
    uint8_t colmod = 0x05;
    esp_lcd_panel_io_tx_param(g_io, 0x3A, &colmod, 1);

    /* 扫描方向 MADCTL */
    uint8_t madctl = NV3007_MADCTL;
    esp_lcd_panel_io_tx_param(g_io, 0x36, &madctl, 1);

    /* Display On */
    esp_lcd_panel_io_tx_param(g_io, 0x29, NULL, 0);
    vTaskDelay(pdMS_TO_TICKS(150));

    /* 反色开 0x20：黑底白字（若仍白屏，尝试 0x21） */
    esp_lcd_panel_io_tx_param(g_io, 0x20, NULL, 0);

    ESP_LOGI(TAG, "NV3007 初始化完成 (MADCTL=0x%02X)", madctl);
    return ESP_OK;
}

/* ==============================================================
 * 区域刷新（坐标自动加 X/Y 偏移）
 * 一次性发送全部数据（分批会导致 CS 时序中断 RAMWR，数据只写部分 → 乱码）
 * 黑白界面（0xFFFF/0x0000）不受 RGB565 字节序影响
 * ============================================================== */
void nv3007_draw_region(int x0, int y0, int x1, int y1, uint16_t *data)
{
    int cx0 = x0 + NV3007_X_OFFSET, cx1 = x1 + NV3007_X_OFFSET;
    int cy0 = y0 + NV3007_Y_OFFSET, cy1 = y1 + NV3007_Y_OFFSET;
    uint8_t col[4] = { (uint8_t)(cx0 >> 8), (uint8_t)(cx0 & 0xFF),
                       (uint8_t)(cx1 >> 8), (uint8_t)(cx1 & 0xFF) };
    uint8_t row[4] = { (uint8_t)(cy0 >> 8), (uint8_t)(cy0 & 0xFF),
                       (uint8_t)(cy1 >> 8), (uint8_t)(cy1 & 0xFF) };
    nv3007_cmd(0x2A, col, 4);
    nv3007_cmd(0x2B, row, 4);

    uint32_t n = (uint32_t)(x1 - x0 + 1) * (y1 - y0 + 1);
    /* 原地 RGB565 字节交换（高字节先发）：发送前交换，发送后还原，
     * 不需要额外大缓冲（避免内存不足导致彩色错乱） */
    for (uint32_t i = 0; i < n; i++)
        data[i] = (uint16_t)((data[i] >> 8) | (data[i] << 8));
    esp_lcd_panel_io_tx_color(g_io, 0x2C, data, n * 2);
    for (uint32_t i = 0; i < n; i++)
        data[i] = (uint16_t)((data[i] >> 8) | (data[i] << 8));
}

void nv3007_fill_screen(uint16_t color)
{
    /* 用一个小缓冲逐行填充，避免超大内存 */
    uint16_t line[NV3007_WIDTH];
    for (int x = 0; x < NV3007_WIDTH; x++) line[x] = color;
    for (int y = 0; y < NV3007_HEIGHT; y++)
        nv3007_draw_region(0, y, NV3007_WIDTH - 1, y, line);
}

/* ==============================================================
 * 三栏英文 UI（1.txt 风格）
 * 自带宽屏帧缓冲 + 6x8 ASCII 字体缩放
 * ============================================================== */

#define UI_WHITE  0xFFFF
#define UI_BLACK  0x0000

static uint16_t g_ui_fb[NV3007_WIDTH * NV3007_HEIGHT];

/* 6x8 ASCII 点阵字库 */
static const uint8_t ui_font_6x8[][6] = {
    {0x00,0x00,0x00,0x00,0x00,0x00}, {0x00,0x00,0x5F,0x00,0x00,0x00},
    {0x00,0x07,0x00,0x07,0x00,0x00}, {0x14,0x7F,0x14,0x7F,0x14,0x00},
    {0x24,0x2A,0x7F,0x2A,0x12,0x00}, {0x23,0x13,0x08,0x64,0x62,0x00},
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    {0x08,0x04,0x08,0x10,0x08,0x00},
};

static inline void ui_set(int x, int y, uint16_t c)
{
    if (x >= 0 && x < NV3007_WIDTH && y >= 0 && y < NV3007_HEIGHT)
        g_ui_fb[y * NV3007_WIDTH + x] = c;
}

void nv3007_ui_clear(void)
{
    for (int i = 0; i < NV3007_WIDTH * NV3007_HEIGHT; i++)
        g_ui_fb[i] = UI_BLACK;
}

void nv3007_ui_fill_rect(int x, int y, int w, int h, uint16_t color)
{
    for (int yy = y; yy < y + h; yy++)
        for (int xx = x; xx < x + w; xx++)
            ui_set(xx, yy, color);
}

void nv3007_ui_draw_vline(int x, int y, int h, uint16_t color)
{
    for (int yy = y; yy < y + h; yy++)
        ui_set(x, yy, color);
}

static void ui_draw_char(int x, int y, char ch, uint8_t size, uint16_t color)
{
    if (ch < 0x20 || ch > 0x7E) return;
    const uint8_t *b = ui_font_6x8[ch - 0x20];
    for (int col = 0; col < 6; col++)
        for (int row = 0; row < 8; row++)
            if (b[col] & (1 << row))
                for (int dy = 0; dy < size; dy++)
                    for (int dx = 0; dx < size; dx++)
                        ui_set(x + col * size + dx, y + row * size + dy, color);
}

static void ui_draw_text(int x, int y, const char *text, uint8_t size, uint16_t color)
{
    int cx = x;
    while (*text) {
        ui_draw_char(cx, y, *text, size, color);
        cx += 6 * size;
        text++;
    }
}

/* 在 [left,right] 区间内水平居中显示（照抄 1.txt panelText） */
void nv3007_ui_panel_text(const char *text, int16_t left, int16_t right,
                          int16_t y, uint8_t size, uint16_t color)
{
    int16_t tw = (int16_t)strlen(text) * 6 * size;
    int16_t x = left + ((right - left) - tw) / 2;
    if (x < left) x = left;
    ui_draw_text(x, y, text, size, color);
}

void nv3007_ui_refresh(void)
{
    nv3007_draw_region(0, 0, NV3007_WIDTH - 1, NV3007_HEIGHT - 1, g_ui_fb);
}

