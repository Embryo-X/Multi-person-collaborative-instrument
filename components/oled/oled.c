/**
 * ==============================================================
 * OLED 绘制层 — NV3007 142x428
 * 帧缓冲 + 中文字模渲染 + 局部刷新
 * 底层驱动由 nv3007 组件提供
 * ==============================================================
 */

#include <string.h>
#include <stdio.h>
#include "esp_log.h"
#include "esp_check.h"
#include "esp_heap_caps.h"
#include "freertos/FreeRTOS.h"
#include "freertos/task.h"

#include "oled.h"
#include "cn_font.h"
#include "nv3007.h"

static const char *TAG = "oled";

#define WHITE  0xFFFF
#define BLACK  0x0000

/* 旧 UI 帧缓冲：heap 动态分配（不占 .bss，节省 RAM 给 BLE） */
static uint16_t *g_fb = NULL;

/* ==============================================================
 * 6x8 ASCII 点阵字库
 * ============================================================== */
static const uint8_t font_6x8[][6] = {
    {0x00,0x00,0x00,0x00,0x00,0x00}, {0x00,0x00,0x5F,0x00,0x00,0x00},
    {0x00,0x07,0x00,0x07,0x00,0x00}, {0x14,0x7F,0x14,0x7F,0x14,0x00},
    {0x24,0x2A,0x7F,0x2A,0x12,0x00}, {0x23,0x13,0x08,0x64,0x62,0x00},
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    {0x08,0x04,0x08,0x10,0x08,0x00},
};

/* ==============================================================
 * 帧缓冲像素操作
 * ============================================================== */
static inline void fb_set(int x, int y, uint16_t c) {
    if (x < OLED_WIDTH && y < OLED_HEIGHT)
        g_fb[y * OLED_WIDTH + x] = c;
}

static void fb_fill(uint16_t c) {
    for (int i = 0; i < OLED_WIDTH * OLED_HEIGHT; i++)
        g_fb[i] = c;
}

/* ---- 画 ASCII 字符到帧缓冲 ---- */
static void draw_asc(int x0, int y0, char ch)
{
    if (ch < 0x20 || ch > 0x7E) return;
    uint8_t idx = ch - 0x20;
    for (int col = 0; col < FONT_ASC_WIDTH; col++) {
        uint8_t b = font_6x8[idx][col];
        for (int row = 0; row < 8; row++) {
            if (b & (1 << row))
                fb_set(x0 + col, y0 + row, WHITE);
        }
    }
}

/* ---- 画中文字符到帧缓冲 ---- */
static void draw_cn(int x0, int y0, const uint8_t *bm)
{
    if (!bm) return;
    for (int col = 0; col < FONT_CN_WIDTH; col++) {
        uint8_t upper = bm[col];       /* 上半 (rows 0-7) */
        uint8_t lower = bm[16 + col];  /* 下半 (rows 8-15) */
        for (int row = 0; row < 8; row++) {
            if (upper & (1 << (7 - row)))
                fb_set(x0 + col, y0 + row, WHITE);
            if (lower & (1 << (7 - row)))
                fb_set(x0 + col, y0 + 8 + row, WHITE);
        }
    }
}

/* ---- UTF-8 ---- */
static uint8_t utf8_len(uint8_t b) {
    if (b < 0x80) return 1;
    if ((b & 0xF0) == 0xE0) return 3;
    return 0;
}

/* 文本横排宽度：中文16px/字，ASCII 6px/字符 */
static uint8_t text_width(const char *s) {
    uint8_t w = 0;
    while (*s) {
        uint8_t l = utf8_len(*s);
        if (l == 1) { w += FONT_ASC_WIDTH; s++; }
        else if (l == 3) { w += FONT_CN_WIDTH; s += 3; }
        else s++;
    }
    return w;
}

/* ==============================================================
 * 公开 API
 * ============================================================== */

esp_err_t oled_init(void)
{
    ESP_RETURN_ON_ERROR(nv3007_init(), TAG, "nv3007_init");

    /* 旧 UI 帧缓冲动态分配；失败则旧 UI 不可用（新三栏 UI 用 nv3007_ui_fb） */
    g_fb = heap_caps_malloc(OLED_WIDTH * OLED_HEIGHT * 2, MALLOC_CAP_DEFAULT);
    if (!g_fb) {
        ESP_LOGW(TAG, "帧缓冲分配失败，旧 UI 不可用");
        return ESP_OK;
    }

    fb_fill(BLACK);
    nv3007_draw_region(0, 0, OLED_WIDTH - 1, OLED_HEIGHT - 1, g_fb);

    ESP_LOGI(TAG, "OLED 绘制层初始化完成");
    return ESP_OK;
}

void oled_clear(void)
{
    fb_fill(BLACK);
    nv3007_draw_region(0, 0, OLED_WIDTH - 1, OLED_HEIGHT - 1, g_fb);
}

void oled_draw_two_lines(const char *l1, const char *l2)
{
    /* 两行横排居中（横屏） */
    int w1 = text_width(l1);
    int w2 = text_width(l2);
    int sx1 = (w1 < OLED_WIDTH) ? (OLED_WIDTH - w1) / 2 : 0;
    int sx2 = (w2 < OLED_WIDTH) ? (OLED_WIDTH - w2) / 2 : 0;
    int sy1 = (OLED_HEIGHT - 40) / 2;
    int sy2 = sy1 + 22;

    fb_fill(BLACK);
    oled_draw_text((uint8_t)sx1, (uint8_t)sy1, l1);
    oled_draw_text((uint8_t)sx2, (uint8_t)sy2, l2);
    nv3007_draw_region(0, 0, OLED_WIDTH - 1, OLED_HEIGHT - 1, g_fb);
}

void oled_draw_vol(uint8_t pct)
{
    char buf[8];
    snprintf(buf, sizeof(buf), "%d%%", (int)pct);
    int w = strlen(buf) * FONT_ASC_WIDTH;
    int sx = OLED_WIDTH - w - 2;
    int sy = 4;
    for (int y = sy; y < sy + 8; y++)
        for (int x = sx; x < OLED_WIDTH; x++)
            fb_set(x, y, BLACK);
    for (int i = 0; buf[i]; i++)
        draw_asc(sx + i * FONT_ASC_WIDTH, sy, buf[i]);
    nv3007_draw_region(sx, sy, OLED_WIDTH - 1, sy + 7, &g_fb[sy * OLED_WIDTH + sx]);
}

void oled_refresh(void)
{
    nv3007_draw_region(0, 0, OLED_WIDTH - 1, OLED_HEIGHT - 1, g_fb);
}

void oled_draw_text(uint8_t x, uint8_t y, const char *text)
{
    int cx = x;
    while (*text && cx < OLED_WIDTH) {
        uint8_t l = utf8_len(*text);
        if (l == 1) {
            draw_asc(cx, y, *text);
            cx += FONT_ASC_WIDTH;
            text++;
        } else if (l == 3) {
            const uint8_t *bm = cn_font_lookup((uint8_t)text[0], (uint8_t)text[1], (uint8_t)text[2]);
            draw_cn(cx, y, bm);
            cx += FONT_CN_WIDTH;
            text += 3;
        } else text++;
    }
}

void oled_draw_center_text(const char *text)
{
    /* 横排黑底白字居中（横屏） */
    int tw = text_width(text);
    int sx = (tw < OLED_WIDTH) ? (OLED_WIDTH - tw) / 2 : 0;
    int sy = (OLED_HEIGHT - 16) / 2;

    fb_fill(BLACK);
    oled_draw_text((uint8_t)sx, (uint8_t)sy, text);
    nv3007_draw_region(0, 0, OLED_WIDTH - 1, OLED_HEIGHT - 1, g_fb);
}
